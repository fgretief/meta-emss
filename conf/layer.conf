## conf/layer.conf
```bitbake
# We have a conf and classes directory, add to BBPATH
BBPATH := "${BBPATH}:${LAYERDIR}"

# We have a packages directory, add to BBFILES
BBFILES += "${LAYERDIR}/recipes/*/*.bb ${LAYERDIR}/recipes/*/*.bbappend"

BBFILE_COLLECTIONS += "emss"
BBFILE_PATTERN_emss := "^${LAYERDIR}/"
BBFILE_PRIORITY_emss = "15"

# Set a variable to get to the top of the layer where the COPYING file is
EMSSBASE := "${LAYERDIR}"
```

## conf/machine/stamp9g20evb.conf
```bitbake
#@TYPE: Machine
#@Name: taskit Stamp9G20 Evaluation Board
#@DESCRIPTION: Machine configuration for the Stamp9G20 Evaluation Board

TARGET_ARCH = "arm"

KERNEL_IMAGETYPE = "uImage"

PREFERRED_PROVIDER_virtual/kernel = "linux-emss"
PREFERRED_VERSION_linux-emss = "3.0.53"

PREFERRED_PROVIDER_virtual/bootloader = "u-boot-emss"
PREFERRED_VERSION_virtual/bootloader = "2012.04.01"

EXTRA_IMAGEDEPENDS += "u-boot-emss"

UBOOT_MACHINE = "stamp9G20_config"

#don't try to access tty1
USE_VT = "0"

MACHINE_FEATURES = "kernel26 ext2 vfat usbhost usbgadget"

# used by sysvinit_2
SERIAL_CONSOLE = "115200 ttyS0"

IMAGE_FSTYPES = "jffs2 tar.gz"

EXTRA_IMAGECMD_jffs2 = "--little-endian --eraseblock=0x20000 -n --pad; \
    sumtool -i ${DEPLOY_DIR_IMAGE}/${IMAGE_NAME}.rootfs.jffs2 -o ${DEPLOY_DIR_IMAGE}/${IMAGE_NAME}.rootfs-summary.jffs2 -e 0x20000 -n --pad; \
    mv ${DEPLOY_DIR_IMAGE}/${IMAGE_NAME}.rootfs-summary.jffs2 ${DEPLOY_DIR_IMAGE}/${IMAGE_NAME}.rootfs.jffs2 \
"

require conf/machine/include/tune-arm926ejs.inc
```
